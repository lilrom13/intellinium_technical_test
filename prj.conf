## CMakeLists.txt
```
cmake_minimum_required(VERSION 3.13.1)

FILE(GLOB MyCSources src/*.c)

include($ENV{ZEPHYR_BASE}/cmake/app/boilerplate.cmake NO_POLICY_SCOPE)
project(intellinium_technical_test)

target_sources(app PRIVATE ${MyCSources})
target_include_directories(app PRIVATE include)
```

## prj.conf
```kconfig
# Configuration
# Incresed stack due to settings API usage
CONFIG_SYSTEM_WORKQUEUE_STACK_SIZE=2048
CONFIG_STDOUT_CONSOLE=y
CONFIG_PRINTK=y

CONFIG_GPIO=y

CONFIG_I2C=y

# This option enables Bluetooth support.
CONFIG_BT=y
# Normal printf-style to console
CONFIG_BT_DEBUG_LOG=y
# This option enables support for the Security Manager Protocol (SMP), making it possible to pair devices over LE.
CONFIG_BT_SMP=y
# This option enables data signing which is used for transferring authenticated data in an unencrypted connection.
CONFIG_BT_SIGNING=y
# Select this for LE Peripheral role support.
CONFIG_BT_PERIPHERAL=y
# Enable GATT Device Information service
CONFIG_BT_GATT_DIS=y
# Number of ATT prepare write buffers
CONFIG_BT_ATT_PREPARE_COUNT=2
# Enable local Privacy Feature support. This makes it possible to use Resolvable Private Addresses (RPAs).
CONFIG_BT_PRIVACY=y
# Bluetooth device name
CONFIG_BT_DEVICE_NAME="Intellimium Technical Test"
# Bluetooth device appearance. For the list of possible values please consult the following link: https://www.bluetooth.com/specifications/assigned-numbers
# CONFIG_BT_DEVICE_APPEARANCE=833
# Enabling this option allows for runtime configuration of Bluetooth device name.
CONFIG_BT_DEVICE_NAME_DYNAMIC=y
# Maximum size in bytes for device name
CONFIG_BT_DEVICE_NAME_MAX=65
CONFIG_BT_FIXED_PASSKEY=y

# Enable support for the flash hardware.
CONFIG_FLASH=y
# Enables API for retrieving the layout of flash memory pages.
CONFIG_FLASH_PAGE_LAYOUT=y
# Enable support of flash map abstraction.
CONFIG_FLASH_MAP=y
# Enable support of Flash Circular Buffer.
CONFIG_FCB=y
# The settings subsystem allows its users to serialize and deserialize state in memory into and from
# non-volatile memory. It supports several back-ends to store and load serialized data from and it
# can do so atomically for all involved modules.
CONFIG_SETTINGS=y
# Use FCB as a settings storage back-end.
CONFIG_SETTINGS_FCB=y
```

## src/main.c
```c
#include "led_work.h"
#include "accel_work.h"
#include "gatt_services.h"
#include "button_interrupts.h"

void main(void)
{
	init_led_work();
	init_accel_work();
	init_gatt_services();

	init_button_interrupts();

	return;
}
```

## include/accel_work.h
```c
#ifndef ACCEL_WORK_H
#define ACCEL_WORK_H

#define I2C_DEV "I2C_0"

int init_accel_work(void);

#endif // ACCEL_WORK_H
```

## include/accelerometer_gatt_service.h
```c
#ifndef ACCELEROMTER_GATT_SERVICE
#define ACCELEROMTER_GATT_SERVICE

int init_acceleromter_service(void);

#endif // ACCELEROMTER_GATT_SERVICE
```

## include/button_interrupts.h
```c
#ifndef BUTTON_INTERRUPTS_H
#define BUTTON_INTERRUPTS_H

int init_button_interrupts(void);

#endif //BUTTON_INTERRUPTS_H
```

## include/gatt_services.h
```c
#ifndef GATT_SERVICE_H
#define GATT_SERVICE_H

int init_gatt_services(void);

#endif // GATT_SERVICE_H
```

## include/led_gatt_service.h
```c
#ifndef LED_GATT_SERVICE
#define LED_GATT_SERVICE

int init_led_service(void);

#endif // LED_GATT_SERVICE
```

## include/led_work.h
```c
#ifndef LED_WORK_H
#define LED_WORK_H

#include <device.h>

#define LED_PORT LED0_GPIO_CONTROLLER
#define LED	LED0_GPIO_PIN

int init_led_work(void);
void test(int value);
void change_frequency(void);

#endif // LED_WORK_H
```

## include/mpu6050_driver.h
```c
#ifndef MPU6050_DRIVER
#define MPU6050_DRIVER

#define ADDR              0x68
#define WHO_I_AM_REG      0x75
#define PWR_MGMT_1_REG    0x6B
#define ACCEL_CONFIG_REG  0x1C

#include <device.h>

int init_mpu6050(struct device *);
int update_accelerometer_values();

s16_t get_accel_x(void);
s16_t get_accel_y(void);
s16_t get_accel_z(void);

#endif //MPU6050_DRIVER
```

## src/accel_work.c
```c
#include <zephyr.h>
#include <misc/printk.h>
#include <device.h>
#include <i2c.h>

#include "accel_work.h"
#include "mpu6050_driver.h"

// accel fetching
static void fetch_accelerometer_work(struct k_work *work)
{
	update_accelerometer_values();
}
K_WORK_DEFINE(accel_work, fetch_accelerometer_work);

static void accel_timer_handler(struct k_timer *dummy)
{
    k_work_submit(&accel_work);
}
K_TIMER_DEFINE(accel_timer, accel_timer_handler, NULL);

int init_accel_work()
{
	struct device *i2c_dev;

	i2c_dev = device_get_binding(I2C_DEV);

	if (!i2c_dev) {
    printk("I2C: Device driver not found.\n");
    return -1;
  }

  // add return check
  init_mpu6050(i2c_dev);

  k_timer_start(&accel_timer, K_SECONDS(0.2), K_SECONDS(0.2));

  return 0;
}
```

## src/accelerometer_gatt_service.c
```c
#include <bluetooth/bluetooth.h>
#include <bluetooth/uuid.h>
#include <bluetooth/gatt.h>

#include "accelerometer_gatt_service.h"
#include "mpu6050_driver.h"

static s16_t axis[3] = {0, 1, 2};// x = 0, y = 1, z = 2

/* Acceleromter Service Variables */
static struct bt_uuid_128 accel_uuid = BT_UUID_INIT_128(
	0xf0, 0xde, 0xbc, 0x9a, 0x78, 0x56, 0x34, 0x12,
	0x78, 0x56, 0x34, 0x12, 0x78, 0x56, 0x34, 0x12);

static struct bt_uuid_128 accel_x_uuid = BT_UUID_INIT_128(
	0xf0, 0xde, 0xbc, 0x9a, 0x78, 0x56, 0x34, 0x12,
	0x78, 0x56, 0x34, 0x12, 0x78, 0x56, 0x34, 0x12);

static struct bt_uuid_128 accel_y_uuid = BT_UUID_INIT_128(
	0xde, 0xde, 0xbc, 0x9a, 0x78, 0x56, 0x34, 0x12,
	0x78, 0x56, 0x34, 0x12, 0x78, 0x56, 0x34, 0x12);

static struct bt_uuid_128 accel_z_uuid = BT_UUID_INIT_128(
	0xbc, 0xde, 0xbc, 0x9a, 0x78, 0x56, 0x34, 0x12,
	0x78, 0x56, 0x34, 0x12, 0x78, 0x56, 0x34, 0x12);

	static ssize_t read_accel(struct bt_conn *conn, const struct bt_gatt_attr *attr,
				void *buf, u16_t len, u16_t offset)
	{
		u16_t value;
		const s16_t *axis = attr->user_data;

		switch (*axis)
		{
			case 0:
				value = get_accel_x();
			case 1:
				value = get_accel_y();
			case 2:
				value = get_accel_z();
		}

		printk("read value = %d\n", value);

		return bt_gatt_attr_read(conn, attr, buf, len, offset, &value,
					 sizeof(value));
	}

/* Acceleromter Service Declaration */
static struct bt_gatt_attr attrs[] = {
	BT_GATT_PRIMARY_SERVICE(&accel_uuid),
	BT_GATT_CHARACTERISTIC(&accel_x_uuid.uuid, BT_GATT_CHRC_READ, BT_GATT_PERM_READ_AUTHEN, read_accel, NULL, &axis[0]),
	BT_GATT_CHARACTERISTIC(&accel_y_uuid.uuid, BT_GATT_CHRC_READ, BT_GATT_PERM_READ_AUTHEN, read_accel, NULL, &axis[1]),
	BT_GATT_CHARACTERISTIC(&accel_z_uuid.uuid, BT_GATT_CHRC_READ, BT_GATT_PERM_READ_AUTHEN, read_accel, NULL, &axis[2]),
};

static struct bt_gatt_service accel_svc = BT_GATT_SERVICE(attrs);

int init_acceleromter_service()
{
  return bt_gatt_service_register(&accel_svc);
}
```

## src/button_interrupts.c
```c
#include <zephyr.h>
#include <device.h>
#include <gpio.h>
#include <misc/util.h>
#include <misc/printk.h>

#include "button_interrupts.h"
#include "led_work.h"

#define PORT	  SW0_GPIO_CONTROLLER
#define PIN     SW0_GPIO_PIN

#define EDGE    (SW0_GPIO_FLAGS | GPIO_INT_EDGE)
#define PULL_UP SW0_GPIO_FLAGS

static struct gpio_callback gpio_cb;

void button_pressed(struct device *gpiob, struct gpio_callback *cb,
		    u32_t pins)
{
	change_frequency();
}

int init_button_interrupts()
{
  struct device *gpiob;

	gpiob = device_get_binding(PORT);
	if (!gpiob) {
		printk("error\n");
		return -1;
	}

	gpio_pin_configure(gpiob, PIN,
			   GPIO_DIR_IN | GPIO_INT |  PULL_UP | EDGE);

	gpio_init_callback(&gpio_cb, button_pressed, BIT(PIN));

	gpio_add_callback(gpiob, &gpio_cb);
	gpio_pin_enable_callback(gpiob, PIN);

  return 0;
}
```

## src/gatt_services.c
```c
#include <misc/printk.h>
#include <settings/settings.h>
#include <bluetooth/bluetooth.h>
#include <bluetooth/conn.h>

#include "gatt_services.h"
#include "accelerometer_gatt_service.h"
#include "led_gatt_service.h"

static const struct bt_data ad[] = {
	BT_DATA_BYTES(BT_DATA_FLAGS, (BT_LE_AD_GENERAL | BT_LE_AD_NO_BREDR))
};

static void connected(struct bt_conn *conn, u8_t err)
{
	if (err) {
		printk("Connection failed (err %u)\n", err);
	} else {
		printk("Connected\n");
	}
}

static void disconnected(struct bt_conn *conn, u8_t reason)
{
	printk("Disconnected (reason %u)\n", reason);
}

static struct bt_conn_cb conn_callbacks = {
	.connected = connected,
	.disconnected = disconnected,
};

static void bt_ready(int err)
{
	if (err) {
		printk("Bluetooth init failed (err %d)\n", err);
		return;
	}

	printk("Bluetooth initialized\n");

	if (init_acceleromter_service() != 0)
	{
		printk("Failed to init acceleromter gatt service\n");
		return;
	}

	printk("Acceleromter gatt initialized\n");

	if (init_led_service() != 0)
	{
		printk("Failed to init led gatt service\n");
		return;
	}

	printk("Led gatt initialized\n");

	if (IS_ENABLED(CONFIG_SETTINGS)) {
		settings_load();
	}

	err = bt_le_adv_start(BT_LE_ADV_CONN_NAME, ad, ARRAY_SIZE(ad), NULL, 0);
	if (err) {
		printk("Advertising failed to start (err %d)\n", err);
		return;
	}

	printk("Advertising successfully started\n");
}

static void auth_passkey_display(struct bt_conn *conn, unsigned int passkey)
{
	char addr[BT_ADDR_LE_STR_LEN];

	bt_addr_le_to_str(bt_conn_get_dst(conn), addr, sizeof(addr));

	printk("Passkey for %s: %06u\n", addr, passkey);
}

static void auth_cancel(struct bt_conn *conn)
{
	char addr[BT_ADDR_LE_STR_LEN];

	bt_addr_le_to_str(bt_conn_get_dst(conn), addr, sizeof(addr));

	printk("Pairing cancelled: %s\n", addr);
}

static struct bt_conn_auth_cb auth_cb_display = {
	.passkey_display = auth_passkey_display,
	.passkey_entry = NULL,
	.cancel = auth_cancel,
};

int init_gatt_services()
{
	int err;

	err = bt_enable(bt_ready);
	if (err) {
		printk("Bluetooth init failed (err %d)\n", err);
		return err;
	}

	bt_conn_cb_register(&conn_callbacks);
	bt_conn_auth_cb_register(&auth_cb_display);

	bt_passkey_set(2569);

	return 0;
}
```

## src/led_gatt_service.c
```c
#include <bluetooth/bluetooth.h>
#include <bluetooth/uuid.h>
#include <bluetooth/gatt.h>

#include "led_work.h"

static u8_t ct;

/* Acceleromter Service Variables */
static struct bt_uuid_128 led_uuid = BT_UUID_INIT_128(
	0xde, 0xde, 0xbc, 0x9a, 0x78, 0x56, 0x34, 0x12,
	0x78, 0x56, 0x34, 0x12, 0x78, 0x56, 0x34, 0x12);

static ssize_t write_ct(struct bt_conn *conn, const struct bt_gatt_attr *attr,
			const void *buf, u16_t len, u16_t offset,
			u8_t flags)
{
	u8_t *value = attr->user_data;

	if (offset + len > sizeof(ct)) {
		return BT_GATT_ERR(BT_ATT_ERR_INVALID_OFFSET);
	}

	memcpy(value + offset, buf, len);

  test(*value);

	return len;
}

/* Acceleromter Service Declaration */
static struct bt_gatt_attr attrs[] = {
	BT_GATT_PRIMARY_SERVICE(&led_uuid),
	BT_GATT_CHARACTERISTIC(&led_uuid.uuid, BT_GATT_CHRC_WRITE, BT_GATT_PERM_WRITE_AUTHEN, NULL, write_ct, &ct),
};

static struct bt_gatt_service led_svc = BT_GATT_SERVICE(attrs);

int init_led_service()
{
  return bt_gatt_service_register(&led_svc);
}
```
